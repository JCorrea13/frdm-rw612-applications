## Wifi-MQTT/frdmrw612_wifi_mqtt/frdmrw612/Kconfig.trace
```kconfig
config CUSTOM_APP_WIFI_MQTT
    bool
    default y
    select MCUX_PRJSEG_config.arm.warn_as_error
    select MCUX_PRJSEG_config.arm.shared
    select MCUX_PRJSEG_config.wireless.shared
    select MCUX_PRJSEG_config.device_core.define
    select MCUX_PRJSEG_config.arm.core.fpu.fpv5_sp
    select MCUX_PRJSEG_config.arm.core.cm33_nodsp_sau
    select MCUX_COMPONENT_CMSIS_Include_core_cm
    select MCUX_PRJSEG_module.device.suite
    select MCUX_COMPONENT_component.silicon_id_rw610
```
